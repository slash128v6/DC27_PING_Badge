/**************************************************
/ PING
/ a "spin" on a classic
/ @slash128
/ DefCon 27
**************************************************/

#include <SPI.h>
#include <Wire.h>
#include <Adafruit_SSD1306.h>
#include <Adafruit_GFX.h>
#include "Fonts/junegull9pt7b.h"

#define SCREEN_WIDTH		128		// OLED display width, in pixels
#define SCREEN_HEIGHT		64		// OLED display height, in pixels

// Declaration for an SSD1306 display connected to I2C (SDA, SCL pins)
#define OLED_RESET			4		// Reset pin # (or -1 if sharing Arduino reset pin)
Adafruit_SSD1306 display(SCREEN_WIDTH, SCREEN_HEIGHT, &Wire, OLED_RESET);

#define NUMJACKS			10		// Number of DC Jacks in the animation example
#define JACKLOOPTIME		50		// Duration for Jack animation
#define PREGAMEDELAY		50		// Duration for Pre Game Screens
#define LOGO_HEIGHT_SMALL	16
#define LOGO_WIDTH_SMALL	16
#define LOGO_HEIGHT_LARGE	128
#define LOGO_WIDTH_LARGE	64
//#define BUZZER				5
#define START				6
#define PLAYER0		    	A0
#define PLAYER1		    	A1
#define MAXLOOP         	25
#define PLAYER_WIDTH 		20
#define PLAYER_HEIGHT 		4
#define PLAYER_REGION 		10
#define BALL_SIZE 			3
#define BALL_REGION			2
int maxScore;
int scorePlayer0 = 0;
int scorePlayer1 = 0;
float ballMoveX = 2;
float ballMoveY = 1;
int BUZZER = 0;

// 'dcjack_bmp_small', 16x16px
const unsigned char dcjack_bmp_small [] PROGMEM = {
	0x00, 0x00, 0x03, 0x80, 0x07, 0xe0, 0x0d, 0xb0, 0x4d, 0xb2, 0x6f, 0xd6, 0xfb, 0xff, 0x0f, 0xf8, 
	0x07, 0xe0, 0x03, 0xc0, 0x0e, 0x70, 0x78, 0x1e, 0x20, 0x0c, 0x20, 0x08, 0x00, 0x00, 0x00, 0x00
};

// 'dcjack_bmp_large', 128x64px
const unsigned char dcjack_bmp_large [] PROGMEM = {
	0x00, 0x00, 0x00, 0x00, 0x00, 0x00, 0x00, 0x00, 0x00, 0x00, 0x00, 0x00, 0x00, 0x00, 0x00, 0x00, 
	0x00, 0x00, 0x00, 0x00, 0x00, 0x00, 0x00, 0x00, 0x00, 0x00, 0x00, 0x00, 0x00, 0x00, 0x00, 0x00, 
	0x00, 0x00, 0x00, 0x00, 0x00, 0x00, 0x00, 0x00, 0x00, 0x00, 0x00, 0x00, 0x00, 0x00, 0x00, 0x00, 
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	0x00, 0x00, 0x00, 0x00, 0x00, 0x00, 0x00, 0x00, 0x00, 0x00, 0x00, 0x00, 0x00, 0x00, 0x00, 0x00
};

// 'CompuNet Logo Large', 128x64px
const unsigned char compuNet_bmp_large [] PROGMEM = {
	0x00, 0x00, 0x00, 0x00, 0x00, 0x00, 0x00, 0x00, 0x00, 0x00, 0x00, 0x00, 0x00, 0x00, 0x00, 0x00, 
	0x00, 0x00, 0x00, 0x00, 0x00, 0x00, 0x00, 0x00, 0x00, 0x00, 0x00, 0x00, 0x00, 0x00, 0x00, 0x00, 
	0x00, 0x00, 0x00, 0x00, 0x00, 0x00, 0x00, 0x00, 0x00, 0x00, 0x00, 0x00, 0x00, 0x00, 0x00, 0x00, 
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	0x00, 0x00, 0x00, 0x00, 0x00, 0x00, 0x00, 0x00, 0x00, 0x00, 0x00, 0x00, 0x00, 0x00, 0x00, 0x00
};

//Setup 
void setup() {
	
  Serial.begin(9600);
  // SSD1306_SWITCHCAPVCC = generate display voltage from 3.3V internally
  
  if(!display.begin(SSD1306_SWITCHCAPVCC, 0x3C)) { // Address 0x3D for 128x64
    Serial.println(F("SSD1306 allocation failed"));
    for(;;); // Don't proceed, loop forever
  }
  
  pinMode(START, INPUT_PULLUP);

  BUZZER = toggleSound();
  selectSound();
  selectMode();

}

//Loop
void loop() {

  introLoop();
  selectSound();
  maxScore = selectMaxScore();
  selectSound();
  ballMoveX, ballMoveY = selectMaxSpeed();
  startSound();
  gameStart();
  pingPlay();
  showWinner();
  gameOver();
  
}

// Function to select between game and bling mode
void selectMode() {
  int buttonState = 1;
  int selectMode = 1;
  int curSelectMode;
  int prvSelectMode;

  while (buttonState) {
	int setMode = analogRead(PLAYER0);
	prvSelectMode = selectMode;
	curSelectMode = map(setMode, 0, 1023, 1, 255);
	if(curSelectMode <= 127) {
		selectMode = 1;
	}
	else {
		selectMode = 2;
	}
    display.clearDisplay(); 
    display.setTextColor(WHITE);
    display.setFont();
    printText(28, 12, WHITE, 1, "Select Mode:");
	if(curSelectMode < 128) {
		printText(45, 32, WHITE, 1, "PING  *");
	    printText(45, 52, WHITE, 1, "BLING  ");
	}
	else {
		printText(45, 32, WHITE, 1, "PING   ");
	    printText(45, 52, WHITE, 1, "BLING *");
	}
    if(prvSelectMode != selectMode) {
		clickSound();
	}
    display.display();
	buttonState = digitalRead(START);
  }
  
  if(curSelectMode >= 128) {
    selectSound();
	blingMode();
  }
  
  else {
	selectSound();
  }

}

// Cycle between bling screens
void blingMode() {
  while(1) {
    drawBitmap(dcjack_bmp_large);
    display.startscrolldiagright(0x00, 0xFF);
    delay(10000);
    selectSound();
    display.stopscroll();
    animateBitmap(dcjack_bmp_small, LOGO_WIDTH_SMALL, LOGO_HEIGHT_SMALL);
	selectSound();
	drawBitmap(compuNet_bmp_large);
    display.startscrolldiagleft(0x00, 0xFF);
    delay(10000);
    selectSound();
    display.stopscroll();
  }
}

void clickSound() {
  tone(BUZZER, 500);
  delay(5);
  noTone(BUZZER);
}

// Function to toggle sound
int toggleSound() {
	
  int buttonState = 1;
  int curSelectSound = 1;
  int prvSelectSound;
  int buzzerPin;
  
  while (buttonState) {
	int setSound = analogRead(PLAYER0);
	prvSelectSound = curSelectSound;
	curSelectSound = map(setSound, 0, 1023, 1, 255);
    display.clearDisplay(); 
    display.setTextColor(WHITE);
    display.setFont();
	if(curSelectSound < 128) {
	  printText(34, 12, WHITE, 1, "Set Sound: ");
	  printText(45, 32, WHITE, 1, "ON   *");
	  printText(45, 52, WHITE, 1, "OFF   ");
	  buzzerPin = 5;
	}
    else {
	  printText(34, 12, WHITE, 1, "Set Sound: ");
	  printText(45, 32, WHITE, 1, "ON    ");
	  printText(45, 52, WHITE, 1, "OFF  *");
	  buzzerPin = 7;
	}
    display.display();
	if(prvSelectSound != curSelectSound) {
		clickSound();
	}
	buttonState = digitalRead(START);
  }
  
  return buzzerPin;
}

// Function to select max score
int selectMaxScore() {
	
  int buttonState = 1;
  int selectScore = 1;
  int prvSelectScore;
  
  while (buttonState) {
	int setScore = analogRead(PLAYER0);
	prvSelectScore = selectScore;
	selectScore = map(setScore, 0, 1023, 1, 20);
    display.clearDisplay(); 
    display.setTextColor(WHITE);
    display.setFont();
    printText(6, 28, WHITE, 1, "Select Max Score: ");
    display.print(selectScore);
    display.display();
	if(prvSelectScore != selectScore) {
		clickSound();
	}
	buttonState = digitalRead(START);
  }
  
  return selectScore;
}

// Function to select max ball speed
int selectMaxSpeed() {
	
  int buttonState = 1;
  int selectSpeed = 1;
  int prvSelectSpeed;
  
  while (buttonState) {
	int setSpeed = analogRead(PLAYER0);
	prvSelectSpeed = selectSpeed;
	selectSpeed = map(setSpeed, 0, 1023, 1, 10);
    display.clearDisplay(); 
    display.setTextColor(WHITE);
    display.setFont();
    printText(6, 28, WHITE, 1, "Select Max Speed: ");
    display.print(selectSpeed);
    display.display();
	if(prvSelectSpeed != selectSpeed) {
		clickSound();
	}
	buttonState = digitalRead(START);
  }
  
  return selectSpeed;
}

// Loop between title and press start screens
void introLoop() {

  int buttonState = 1;
	
  loopStart:

  // Title Screen
  for(int i = 0; i < MAXLOOP*2; i++) {
    display.clearDisplay(); 
    display.setTextColor(WHITE);
	display.setFont(&junegull9pt7b);
	printText(32, 20, WHITE, 2, "PING");
	display.setFont();
    printText(0, 30, WHITE, 1, "a \"spin\" on a classic");
	printText(36, 46, WHITE, 1, "@slash128");
	printText(36, 56, WHITE, 1, "DefCon 27");
	display.display();
    buttonState = digitalRead(START);
	if(!buttonState) {
		buttonState = 0;
		break;
	}
  }

  if(!buttonState) {
	  return;
  }

  // Press start screen and sound
  for(int i = 0; i < MAXLOOP; i++) {
    display.clearDisplay();
    display.setTextColor(WHITE);
	printText(29, 30, WHITE, 1, "Press Start!");
    display.display();
    delay(100);
	buttonState = digitalRead(START);
	if(!buttonState) {
	  buttonState = 0;
	  break;
	}
    display.clearDisplay();
	display.display();
    delay(100);
    buttonState = digitalRead(START);
	if(!buttonState) {
      buttonState = 0;
	  break;
	}
  }
  
  if(buttonState) {
	  goto loopStart;
  }
    
}

void pingPlay() {

  int pot0, pot1;  
  int locPlayer0 = 0;
  int locPlayer1 = 0;
  int ballPossession;
  float ballLocX = SCREEN_WIDTH / 2;
  float ballLocY = SCREEN_HEIGHT / 2;

  do {	
    pot0 = analogRead(PLAYER0);
    pot1 = analogRead(PLAYER1);
    locPlayer0 = map(pot0, 0, 1023, 0, SCREEN_WIDTH - PLAYER_WIDTH);
    locPlayer1 = map(pot1, 0, 1023, 0, SCREEN_WIDTH - PLAYER_WIDTH);
	
	// Draw court
    display.clearDisplay();
    display.setTextColor(WHITE);
    display.setTextSize(1);
    display.fillRect(ballLocX,ballLocY,BALL_SIZE,BALL_SIZE,WHITE);
    display.fillRect(locPlayer0,SCREEN_HEIGHT-PLAYER_HEIGHT,PLAYER_WIDTH,PLAYER_HEIGHT,WHITE);
    display.fillRect(locPlayer1,SCREEN_HEIGHT-PLAYER_HEIGHT,PLAYER_WIDTH,PLAYER_HEIGHT,WHITE);
    for (int i=0; i<SCREEN_HEIGHT; i++) {
      display.drawFastVLine(0, i, 2, WHITE);
    }
    for (int i=0; i<SCREEN_WIDTH; i++) {
      display.drawFastHLine(i, 0, 2, WHITE);
    }
    for (int i=0; i<SCREEN_WIDTH; i+=6) {
      display.drawFastHLine(i, SCREEN_HEIGHT/2, 2, WHITE);
    }
    for (int i=0; i<SCREEN_HEIGHT; i++) {
      display.drawFastVLine(127, i, 2, WHITE);
    }
    display.setCursor(10, 23);
    display.print(scorePlayer0);
    display.setCursor(110, 23);
    display.print(scorePlayer1);
    display.display();
	ballLocX += ballMoveX;
    ballLocY += ballMoveY;
	
	// Bounce sides
    if (ballLocX >= SCREEN_WIDTH - BALL_SIZE || ballLocX <= 0) {
      ballMoveX *= -1;
      wallSound();
	}
	
	// Bounce top
	if (ballLocY <= 0 + BALL_SIZE + BALL_REGION) {
      ballMoveY *= -1;
      wallSound();
    }
	
	// Bounce player0
	if (ballLocY >= 57 && ballMoveY > 0) {
      if (ballLocX > locPlayer0 - 5 && ballLocX < locPlayer0 + PLAYER_WIDTH + 5) {
        paddleSound();
        ballMoveY *= -1;
		ballPossession = 0;
      }
    }
	
	// Bounce player1
    if (ballLocY >= 57 && ballMoveY > 0) {
      if (ballLocX > locPlayer1 - 5 && ballLocX < locPlayer1 + PLAYER_WIDTH + 5) {
        paddleSound();
        ballMoveY *= -1;
		ballPossession = 1;
      }
	}
	
	// Scoring
	if (ballLocY >= SCREEN_HEIGHT - BALL_SIZE || ballLocY <= 0) {
        if (ballPossession) {
          scorePlayer1++;
          ballLocX = random(7, SCREEN_WIDTH - 7);
		  ballLocY = random(7, SCREEN_HEIGHT / 2);
        }
		
		else {
		  scorePlayer0++;
          ballLocX = random(7, SCREEN_WIDTH - 7);
		  ballLocY = random(7, SCREEN_HEIGHT / 2);
        }
		
      pointSound();   
    }
        
  } while(!(scorePlayer0 >= maxScore) && !(scorePlayer1 >= maxScore));
  
  // Draw final score screen
  display.clearDisplay();
  display.setTextColor(WHITE);
  display.setTextSize(1);
  display.fillRect(ballLocX,ballLocY,BALL_SIZE,BALL_SIZE,WHITE);
  display.fillRect(locPlayer0,SCREEN_HEIGHT-PLAYER_HEIGHT,PLAYER_WIDTH,PLAYER_HEIGHT,WHITE);
  display.fillRect(locPlayer1,SCREEN_HEIGHT-PLAYER_HEIGHT,PLAYER_WIDTH,PLAYER_HEIGHT,WHITE);
  for (int i=0; i<SCREEN_HEIGHT; i++) {
    display.drawFastVLine(0, i, 2, WHITE);
  }
   for (int i=0; i<SCREEN_WIDTH; i++) {
      display.drawFastHLine(i, 0, 2, WHITE);
  }
  for (int i=0; i<SCREEN_WIDTH; i+=6) {
    display.drawFastHLine(i, SCREEN_HEIGHT/2, 2, WHITE);
  }
  for (int i=0; i<SCREEN_HEIGHT; i++) {
    display.drawFastVLine(127, i, 2, WHITE);
  }
  display.setCursor(10, 23);
  display.print(scorePlayer0);
  display.setCursor(110, 23);
  display.print(scorePlayer1);
  display.display();
  delay(1000);
}

// Function to consolidate printing text
void printText(int x, int y, const char* color, int size, const char* text) {
  display.setCursor(x, y);
  display.setTextColor(color);
  display.setTextSize(size);
  display.print(text);
}

// Game start screen and sound
void gameStart() {
  display.clearDisplay();
  printText(31, 25, WHITE, 2, "Ready!");
  display.display();
  tone(BUZZER, 250);
  delay(250);
  noTone(BUZZER);
  delay(1000);
  display.clearDisplay();
  printText(41, 25, WHITE, 2, "Set!");
  display.display();
  tone(BUZZER, 250);
  delay(250);
  noTone(BUZZER);
  delay(1000);
  display.clearDisplay();
  printText(48, 25, WHITE, 2, "Go!");
  display.display();
  tone(BUZZER, 500);
  delay(500);
  noTone(BUZZER);
  delay(1000);
}

// Show winner screen
void showWinner() {
  display.clearDisplay();
  delay(500);
  if(scorePlayer0 > scorePlayer1) {
  	//printText(48, 12, WHITE, 1, "Left");
  	printText(38, 24, WHITE, 1, "Player 1");
  	printText(47, 38, WHITE, 1, "Wins!");
  	display.display();
  	delay(5000);
  } else {
  	//printText(46, 12, WHITE, 1, "Right");
  	printText(38, 24, WHITE, 1, "Player 2");
  	printText(47, 38, WHITE, 1, "Wins!");
  	display.display();
  	delay(5000);
  }
  
  // Reset Scores
  scorePlayer0 = 0;
  scorePlayer1 = 0;
}

// Game over screen and sound
void gameOver() {
  display.clearDisplay();
  printText(28, 6, WHITE, 3, "GAME");
  printText(28, 38, WHITE, 3, "OVER");
  display.display();
  endSound();
  delay(3000);
  
}

void endSound() {
  tone(BUZZER, 350);
  delay(300);
  noTone(BUZZER);
  delay(150);
  tone(BUZZER, 350);
  delay(300);
  noTone(BUZZER);
  delay(150);
  tone(BUZZER, 350);
  delay(300);
  noTone(BUZZER);
  delay(150);
  tone(BUZZER, 300);
  delay(1000);
  noTone(BUZZER);
}

void paddleSound() {
  tone(BUZZER, 459, 96);
}

void pointSound() {
  tone(BUZZER, 490, 257);
}

void selectSound() {
  tone(BUZZER, 512);
  delay(64);
  noTone(BUZZER);
  delay(64);
  tone(BUZZER, 1024);
  delay(64);
  noTone(BUZZER);
  delay(500);
}

void startSound() {
  tone(BUZZER, 128);
  delay(64);
  noTone(BUZZER);
  delay(64);
  tone(BUZZER, 256);
  delay(64);
  noTone(BUZZER);
  delay(64);
  tone(BUZZER, 512);
  delay(64);
  noTone(BUZZER);
  delay(64);
  tone(BUZZER, 1024);
  delay(64);
  noTone(BUZZER);
  delay(64);
  tone(BUZZER, 512);
  delay(64);
  noTone(BUZZER);
  delay(64);
  tone(BUZZER, 1024);
  delay(64);
  noTone(BUZZER);
  delay(500);
}

void wallSound() {
  tone(BUZZER, 226, 16);
}

void drawBitmap(const uint8_t *bitmap) {
  display.clearDisplay();
  display.drawBitmap(0, 0, bitmap, 128, 64, 1);
  display.display();
}

#define XPOS   0 // Indexes into the 'icons' array in function below
#define YPOS   1
#define DELTAY 2

void animateBitmap(const uint8_t *bitmap, uint8_t w, uint8_t h) {
  int8_t f, icons[NUMJACKS][3];

  // Initialize 'DC Jack' positions
  for(f=0; f< NUMJACKS; f++) {
    icons[f][XPOS]   = random(1 - LOGO_WIDTH_SMALL, display.width());
    icons[f][YPOS]   = -LOGO_HEIGHT_SMALL;
    icons[f][DELTAY] = random(1, 6);
    Serial.print(F("x: "));
    Serial.print(icons[f][XPOS], DEC);
    Serial.print(F(" y: "));
    Serial.print(icons[f][YPOS], DEC);
    Serial.print(F(" dy: "));
    Serial.println(icons[f][DELTAY], DEC);
  }

  for(int i = 0; i < JACKLOOPTIME; i++) { // Loop for a time...
    display.clearDisplay(); // Clear the display buffer

    // Draw each 'DC Jack':
    for(f=0; f< NUMJACKS; f++) {
      display.drawBitmap(icons[f][XPOS], icons[f][YPOS], bitmap, w, h, WHITE);
    }

    display.display(); // Show the display buffer on the screen
    delay(200);        // Pause for 1/10 second

    // Then update coordinates of each flake...
    for(f=0; f< NUMJACKS; f++) {
      icons[f][YPOS] += icons[f][DELTAY];
      // If snowflake is off the bottom of the screen...
      if (icons[f][YPOS] >= display.height()) {
        // Reinitialize to a random position, just off the top
        icons[f][XPOS]   = random(1 - LOGO_WIDTH_SMALL, display.width());
        icons[f][YPOS]   = -LOGO_HEIGHT_SMALL;
        icons[f][DELTAY] = random(1, 6);
      }
    }
  }
}